## Firmware/ESP32/main/Kconfig
```kconfig
menu "OGXMini Options"

    config I2C_RING_BUFFER_SIZE
        int "Set I2C ring buffer size"
        default 6

    config I2C_PORT
        int "Set I2C port"
        default 0

    config I2C_SDA_PIN
        int "Set I2C SDA pin"
        default 21

    config I2C_SCL_PIN
        int "Set I2C SCL pin"
        default 22

    config I2C_BAUDRATE
        int "Set I2C baudrate"
        default 1000000

    config RESET_PIN
        int "Set reset pin"
        default 9

    config MULTI_SLAVE_MODE
        bool "Enable multiple slave devices"
        default n

    config ENABLE_LED_1
        bool "Enable LED 1"
        default y

    config LED_PIN_1
        int "Set LED 1 pin"
        default 15
        depends on ENABLE_LED_1

    config ENABLE_LED_2
        bool "Enable LED 2"
        default n
        depends on ENABLE_LED_1

    config LED_PIN_2
        int "Set LED 2 pin"
        default 255
        depends on ENABLE_LED_2

    config ENABLE_LED_3
        bool "Enable LED 3"
        default n
        depends on ENABLE_LED_2

    config LED_PIN_3
        int "Set LED 3 pin"
        default 255
        depends on ENABLE_LED_3

    config ENABLE_LED_4
        bool "Enable LED 4"
        default n
        depends on ENABLE_LED_3

    config LED_PIN_4
        int "Set LED 4 pin"
        default 255
        depends on ENABLE_LED_4
    
endmenu
```

## Firmware/ESP32/sdkconfig.defaults
```kconfig
#
# ESP32 options
#
CONFIG_COMPILER_OPTIMIZATION_PERF=y

CONFIG_ESPTOOLPY_FLASHSIZE_4MB=y

CONFIG_ESP32_XTAL_FREQ_AUTO=y
CONFIG_XTAL_FREQ_AUTO=y

# Bluetooh related
CONFIG_BT_ENABLED=y
CONFIG_BT_CONTROLLER_ONLY=y
# Enable Dualmode (BLE and BR/EDR)
CONFIG_BTDM_CTRL_MODE_BTDM=y
#CONFIG_BTDM_CTRL_MODE_BR_EDR_ONLY=y
# Should be, at least, one more than CONFIG_BLUEPAD32_MAX_DEVICES
# See: https://gitlab.com/ricardoquesada/bluepad32/-/issues/11
CONFIG_BTDM_CTRL_BR_EDR_MAX_ACL_CONN=5
CONFIG_BTDM_CTRL_BLE_MAX_CONN=5
CONFIG_BTDM_CTRL_BR_EDR_MAX_SYNC_CONN=0
CONFIG_BTDM_CTRL_AUTO_LATENCY=y
CONFIG_BTDM_CTRL_MODEM_SLEEP=n

CONFIG_ESP_COREDUMP_ENABLE_TO_FLASH=y

#
# FreeRTOS
#
# Enable FreeRTOS stats formatting functions, needed for 'tasks' console command
CONFIG_FREERTOS_USE_TRACE_FACILITY=y
CONFIG_FREERTOS_USE_STATS_FORMATTING_FUNCTIONS=y

#
# Bluepad32 options
#
CONFIG_BLUEPAD32_MAX_DEVICES=4
CONFIG_BLUEPAD32_PLATFORM_CUSTOM=y

#
# Add here other options
#
```
